## examples/diagnostics/sdkconfig.defaults
```kconfig
CONFIG_IDF_TARGET="esp32s31"
CONFIG_ESPTOOLPY_FLASHSIZE_16MB=y
CONFIG_PARTITION_TABLE_SINGLE_APP_LARGE=y
CONFIG_FREERTOS_HZ=1000
CONFIG_ESP_CONSOLE_USB_SERIAL_JTAG=y
CONFIG_ESP_CONSOLE_SECONDARY_NONE=y
```

## examples/display/main/Kconfig.projbuild
```kconfig
menu "Candis display example"

config CANDIS_BENCH_PANEL_POWER
    bool "Allow the example to enable the AMOLED rail"
    default n
    help
        Enable for a measured setup compatible with a nominal 3.3 V ALDO1.

config CANDIS_BENCH_QSPI_50MHZ
    bool "Use 50 MHz QSPI for comparison"
    default n

config CANDIS_BENCH_AUTORUN
    bool "Automatically measure partial, full and scan refresh and restart the display"
    default n

config CANDIS_BENCH_ROUNDS
    int "Refresh benchmark and restart cycles"
    depends on CANDIS_BENCH_AUTORUN
    range 1 100
    default 1

config CANDIS_BENCH_SYNC_FLUSH
    bool "Use synchronous AMOLED transfers for comparison"
    default n
    help
        Use one PSRAM framebuffer and wait for panel IO inside the LVGL refresh.

endmenu
```

## examples/expansion/main/Kconfig.projbuild
```kconfig
menu "Candis expansion example"

    config CANDIS_EXPANSION_DISPLAY
        bool "Show expansion status on AMOLED"
        depends on SPIRAM
        default n
        help
            Requires an externally powered Candis AMOLED. Uses the board's
            LVGL display and leaves the panel power under its existing owner.

    config CANDIS_EXPANSION_SHARED_SW5
        bool "Sample SW5 on the shared BMI270 INT1 line"
        default n
        help
            Enable after checking the rail sequence and verifying that INT1
            is high impedance for the entire input session.

    config CANDIS_EXPANSION_TF_WRITE_TEST
        bool "Verify write and readback on each inserted Dock test card"
        default n
        help
            Use a writable FAT test card. Create one exclusive 4 KiB test
            file, synchronize it, verify it after reopening, and remove it.

    config CANDIS_EXPANSION_DOCK_MODULE_SCAN
        bool "Probe the two expected Dock module EEPROM addresses"
        default n
        help
            Enable with verified modules and compatible expansion I2C
            pull-ups. Report ACK at addresses 0x51 and 0x52 once after
            the Dock descriptor has been validated.

endmenu
```

## examples/motion/main/Kconfig.projbuild
```kconfig
menu "Candis motion example"

config CANDIS_MOTION_MANAGE_POWER
    bool "Power the expansion domain for a verified assembly"
    default n

config CANDIS_MOTION_TEST_STORAGE
    bool "Run shared-power checks with a TF card"
    default n
    help
        Uses the Dock card detect pin GPIO39 by default. Keep LEFT U6 empty
        or leave its GPIO39 connection high impedance.

config CANDIS_MOTION_FIXTURE
    bool "Use the validation fixture card detect pin GPIO35"
    depends on CANDIS_MOTION_TEST_STORAGE
    default n

endmenu
```

## examples/music_player/main/Kconfig.projbuild
```kconfig
menu "Candis music player"

config CANDIS_MUSIC_PLAYER_MANAGE_PANEL_POWER
    bool "Allow the player to enable ALDO1"
    default n
    help
        Enable on a characterized fixture compatible with a nominal 3.3 V ALDO1.

config CANDIS_MUSIC_PLAYER_MANAGE_AUDIO_POWER
    bool "Allow the player to enable ALDO2 during playback"
    default n
    help
        Enable on the audio fixture with the board's speaker connections.

endmenu
```

## examples/power/main/Kconfig.projbuild
```kconfig
menu "Candis TG28-ESP example"

config CANDIS_POWER_DEMO_PANEL_POWER
    bool "Allow the example to power the verified 3.3 V AMOLED fixture"
    default n

config CANDIS_POWER_DEMO_CHARGE_TEST
    bool "Enable the supervised 25 mA charge setpoint test"
    default n
    help
        Adds a two-step touchscreen action that temporarily reduces the
        200 mA setpoint to 25 mA during constant-current charging.

endmenu
```

## examples/power/sdkconfig.defaults
```kconfig
CONFIG_IDF_TARGET="esp32s31"
CONFIG_ESPTOOLPY_FLASHSIZE_16MB=y
CONFIG_PARTITION_TABLE_SINGLE_APP_LARGE=y
CONFIG_FREERTOS_HZ=1000
CONFIG_SPIRAM=y
CONFIG_SPIRAM_SPEED_200M=y
CONFIG_SPIRAM_USE_CAPS_ALLOC=y
CONFIG_ESP_CONSOLE_USB_SERIAL_JTAG=y
CONFIG_ESP_CONSOLE_SECONDARY_NONE=y
CONFIG_LV_COLOR_DEPTH_16=y
CONFIG_LV_DRAW_BUF_ALIGN=64
CONFIG_LV_FONT_MONTSERRAT_20=y
CONFIG_LV_FONT_MONTSERRAT_32=y
CONFIG_ESP_LCD_TOUCH_MAX_POINTS=2
```

## examples/tf_card/main/Kconfig.projbuild
```kconfig
menu "Candis TF card example"

choice CANDIS_TF_BOARD
    prompt "TF card connector"
    default CANDIS_TF_FIXTURE

config CANDIS_TF_FIXTURE
    bool "Validation fixture (GPIO35 card detect)"

config CANDIS_TF_EXPANSION
    bool "Dock or Gamepad (GPIO39 card detect)"

endchoice

config CANDIS_TF_MANAGE_POWER
    bool "Enable DC1SW for the attached fixture"
    help
        Only enable for an expansion domain with known loads. The example
        holds DC1SW until Q is received on the console.

config CANDIS_TF_WRITE_TEST
    bool "Enable the explicit W command to verify a 4 KiB temporary file"
    help
        Use a test card. The example opens an unused filename exclusively,
        synchronizes and compares its contents, then removes the file.

endmenu
```

## examples/tf_card/sdkconfig.defaults
```kconfig
CONFIG_IDF_TARGET="esp32s31"
CONFIG_ESPTOOLPY_FLASHSIZE_16MB=y
CONFIG_PARTITION_TABLE_SINGLE_APP_LARGE=y
CONFIG_FREERTOS_HZ=1000
CONFIG_ESP_CONSOLE_USB_SERIAL_JTAG=y
CONFIG_ESP_CONSOLE_SECONDARY_NONE=y
CONFIG_COMPILER_OPTIMIZATION_PERF=y
CONFIG_SPIRAM=y
CONFIG_SPIRAM_SPEED_200M=y
CONFIG_SPIRAM_USE_CAPS_ALLOC=y
CONFIG_ESP_MAIN_TASK_STACK_SIZE=8192
CONFIG_LV_COLOR_DEPTH_16=y
CONFIG_LV_DEF_REFR_PERIOD=10
CONFIG_LV_DRAW_BUF_ALIGN=64
CONFIG_LV_FONT_MONTSERRAT_14=y
CONFIG_LV_FONT_DEFAULT_MONTSERRAT_14=y
CONFIG_ESP_LCD_TOUCH_MAX_POINTS=2
```

## examples/tg28/main/Kconfig.projbuild
```kconfig
menu "TG28-ESP monitor"

    config TG28_EXAMPLE_SCL
        int "I2C SCL GPIO"
        default 6

    config TG28_EXAMPLE_SDA
        int "I2C SDA GPIO"
        default 7

    config TG28_EXAMPLE_SAMPLES
        int "Number of samples before releasing the bus"
        range 1 3600
        default 20

    config TG28_EXAMPLE_SCRATCH_TEST
        bool "Verify and restore PMU scratch bytes on a dedicated fixture"
        default n
        help
            Temporarily writes REG04-07 and restores the previous values.
            Use only when no bootloader or other processor owns these bytes.

endmenu
```

## tests/bsp_api/sdkconfig.defaults
```kconfig
CONFIG_IDF_TARGET="esp32s31"
CONFIG_ESPTOOLPY_FLASHSIZE_16MB=y
CONFIG_PARTITION_TABLE_SINGLE_APP_LARGE=y
CONFIG_FREERTOS_HZ=1000
CONFIG_SPIRAM=y
CONFIG_ESP_CONSOLE_USB_SERIAL_JTAG=y
CONFIG_ESP_CONSOLE_SECONDARY_NONE=y
CONFIG_CANDIS_AUDIO=y
CONFIG_CANDIS_IMU=y
CONFIG_CANDIS_USB_DEVICE=y
CONFIG_CANDIS_USB_HOST=y
```
