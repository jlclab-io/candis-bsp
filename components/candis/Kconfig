## components/candis/Kconfig
```kconfig
menu "Candis BSP"

config CANDIS_NO_GRAPHIC_LIB
    bool "Build the raw AMOLED and touch APIs without LVGL"
    default n
    help
        Keep the native QSPI panel and CST9220 APIs. Do not build the LVGL
        task or pull LVGL and esp_lvgl_port into this application.

config CANDIS_AUDIO
    bool "Build the Candis ES8389 audio interface"
    default n
    select CODEC_ES8389_SUPPORT

config CANDIS_IMU
    bool "Build the configurable BMI270 interface"
    default n
    help
        Build the BMI270 driver. The application supplies the powered I2C bus,
        device address, output data rate, and measurement ranges at runtime.

config BSP_SD_MOUNT_POINT
    string "Default BSP TF mount point"
    default "/sdcard"
    help
        Mount path used by bsp_sdcard_mount(). Configure the SDMMC transport
        through candis_storage_configure() before mounting.

config CANDIS_USB_DEVICE
    bool "Build native OTG CDC device support"
    depends on !ESP_CONSOLE_USB_CDC
    default n
    select TINYUSB_CDC_ENABLED

config CANDIS_USB_HOST
    bool "Build native OTG host support"
    depends on !ESP_CONSOLE_USB_CDC
    default n
    help
        Use only in a verified USB-C source setup. Candis hardware controls
        the VBUS source and the output current limit.

endmenu
```

## components/candis_ov5640/Kconfig
```kconfig
config CANDIS_OV5640_FIXTURE
    bool "Candis OV5640 validation fixture preset"
    default y
    help
        Include the Candis validation fixture pin map and shared power adapter.
        Disable for applications that supply their own camera configuration.
```

## examples/adc/main/Kconfig.projbuild
```kconfig
menu "Candis ADC example"

choice CANDIS_ADC_CONNECTOR
    prompt "ADC input pair"
    default CANDIS_ADC_DOCK

config CANDIS_ADC_DOCK
    bool "External analog inputs on Dock LEFT (U6.20/GPIO42 and U6.18/GPIO43)"

config CANDIS_ADC_FIXTURE
    bool "Validation fixture joystick (GPIO43 and GPIO44)"

endchoice

config CANDIS_ADC_MANAGE_POWER
    bool "Power the fixture joystick through DC1SW"
    depends on CANDIS_ADC_FIXTURE
    help
        Only enable with the Candis validation fixture. The example turns on
        DC1SW during sampling and restores its original state afterward.

endmenu
```

## examples/audio/main/Kconfig.projbuild
```kconfig
menu "Candis audio recorder"

config CANDIS_RECORDER_MANAGE_PANEL_POWER
    bool "Allow the recorder to enable ALDO1"
    default n
    help
        Enable on a characterized fixture compatible with a nominal 3.3 V ALDO1.

config CANDIS_RECORDER_MANAGE_AUDIO_POWER
    bool "Allow the recorder to enable ALDO2 during capture and playback"
    default n
    help
        Enable on the audio fixture with the board's microphone and speaker connections.

endmenu
```

## examples/audio/sdkconfig.defaults
```kconfig
CONFIG_IDF_TARGET="esp32s31"
CONFIG_ESPTOOLPY_FLASHSIZE_16MB=y
CONFIG_PARTITION_TABLE_SINGLE_APP_LARGE=y
CONFIG_FREERTOS_HZ=1000
CONFIG_COMPILER_OPTIMIZATION_PERF=y
CONFIG_ESP_CONSOLE_USB_SERIAL_JTAG=y
CONFIG_ESP_CONSOLE_SECONDARY_NONE=y
CONFIG_ESP_MAIN_TASK_STACK_SIZE=8192
CONFIG_SPIRAM=y
CONFIG_SPIRAM_SPEED_200M=y
CONFIG_LV_COLOR_DEPTH_16=y
CONFIG_LV_FONT_MONTSERRAT_20=y
CONFIG_LV_FONT_MONTSERRAT_32=y
CONFIG_CANDIS_AUDIO=y
```

## examples/ble_scan/main/Kconfig.projbuild
```kconfig
menu "Candis BLE scan example"

config CANDIS_BLE_SCAN_PEER_UUID
    string "Optional peer's 128-bit Service Data UUID"
    default ""
    help
        Enter a canonical UUID such as 01234567-89ab-cdef-0123-456789abcdef.
        The scanner counts advertisements containing Service Data with this
        UUID and reports their strongest RSSI alongside the overall count.

endmenu
```

## examples/bleprph_wifi_coex/main/Kconfig.projbuild
```kconfig
menu "Candis Wi-Fi and BLE coexistence example"

    config EXAMPLE_ESP_WIFI_SSID
        string "WiFi SSID"
        default ""
        help
            SSID (network name) for the example to connect to.

    config EXAMPLE_ESP_WIFI_PASSWORD
        string "WiFi Password"
        default ""
        help
            Wi-Fi password for the example access point.

    config EXAMPLE_ESP_MAXIMUM_RETRY
        int "WIFI Connect Maximum retry"
        default 5
        help
            Set the Maximum retry to avoid station reconnecting to the AP unlimited when the AP is really inexistent.

    config EXAMPLE_HTTP_URL
        string "HTTP URL for internet check"
        default "http://example.com/"
        help
            Plain HTTP endpoint used to verify internet access after the station gets an IP address.
endmenu
```

## examples/bleprph_wifi_coex/sdkconfig.defaults
```kconfig
CONFIG_IDF_TARGET="esp32s31"
CONFIG_ESPTOOLPY_FLASHSIZE_16MB=y
CONFIG_PARTITION_TABLE_SINGLE_APP_LARGE=y
CONFIG_FREERTOS_HZ=1000
CONFIG_COMPILER_OPTIMIZATION_SIZE=y
CONFIG_MBEDTLS_COMPILER_OPTIMIZATION_SIZE=y
CONFIG_ESP_CONSOLE_USB_SERIAL_JTAG=y
CONFIG_ESP_CONSOLE_SECONDARY_NONE=y
CONFIG_ESP_MAIN_TASK_STACK_SIZE=8192
CONFIG_CANDIS_EXAMPLE_USB_CDC=y
CONFIG_CANDIS_EXAMPLE_USB_DOWNLOAD=y
CONFIG_BT_ENABLED=y
CONFIG_BT_BLUEDROID_ENABLED=n
CONFIG_BT_NIMBLE_ENABLED=y
CONFIG_ESP_COEX_SW_COEXIST_ENABLE=y
CONFIG_ESP_WIFI_IRAM_OPT=n
CONFIG_MBEDTLS_CERTIFICATE_BUNDLE=n
```

## examples/camera/main/Kconfig.projbuild
```kconfig
menu "Candis camera preview"

config CANDIS_CAMERA_FIXTURE
    bool "Use the OV5640 wiring of the Candis validation fixture"
    default n
    select CAMERA_OV5640
    select CAMERA_OV5640_AUTO_DETECT_DVP_INTERFACE_SENSOR
    help
        Only enable with the validation fixture physically attached.
        The fixture drives GPIO39 as camera reset. Candis Dock uses that
        pin for TF card detect.

config CANDIS_CAMERA_ENABLE_ALL_DVP_SENSORS
    bool "Build all Espressif 8-bit DVP sensor drivers"
    default n
    depends on !CANDIS_CAMERA_FIXTURE
    select CAMERA_BF20A6
    select CAMERA_BF20A6_AUTO_DETECT_DVP_INTERFACE_SENSOR
    select CAMERA_BF3031
    select CAMERA_BF3031_AUTO_DETECT_DVP_INTERFACE_SENSOR
    select CAMERA_BF3045
    select CAMERA_BF3045_AUTO_DETECT_DVP_INTERFACE_SENSOR
    select CAMERA_BF3925
    select CAMERA_BF3925_AUTO_DETECT_DVP_INTERFACE_SENSOR
    select CAMERA_BF3A03
    select CAMERA_BF3A03_AUTO_DETECT_DVP_INTERFACE_SENSOR
    select CAMERA_GC0308
    select CAMERA_GC0308_AUTO_DETECT_DVP_INTERFACE_SENSOR
    select CAMERA_GC032A
    select CAMERA_GC032A_AUTO_DETECT_DVP_INTERFACE_SENSOR
    select CAMERA_GC2145
    select CAMERA_GC2145_AUTO_DETECT_DVP_INTERFACE_SENSOR
    select CAMERA_MT9D111
    select CAMERA_MT9D111_AUTO_DETECT_DVP_INTERFACE_SENSOR
    select CAMERA_OV2640
    select CAMERA_OV2640_AUTO_DETECT_DVP_INTERFACE_SENSOR
    select CAMERA_OV3640
    select CAMERA_OV3640_AUTO_DETECT_DVP_INTERFACE_SENSOR
    select CAMERA_OV3660
    select CAMERA_OV3660_AUTO_DETECT_DVP_INTERFACE_SENSOR
    select CAMERA_OV5640
    select CAMERA_OV5640_AUTO_DETECT_DVP_INTERFACE_SENSOR
    select CAMERA_SC030IOT
    select CAMERA_SC030IOT_AUTO_DETECT_DVP_INTERFACE_SENSOR
    select CAMERA_SC101IOT
    select CAMERA_SC101IOT_AUTO_DETECT_DVP_INTERFACE_SENSOR
    select CAMERA_SC2336
    select CAMERA_SC2336_AUTO_DETECT_DVP_INTERFACE_SENSOR
    select CAMERA_SP0A39
    select CAMERA_SP0A39_AUTO_DETECT_DVP_INTERFACE_SENSOR
    help
        Include every sensor with an 8-bit DVP mode in Espressif ESP Cam Sensor
        2.7.0. Each sensor uses its default Kconfig format.

choice CANDIS_CAMERA_SINGLE_SENSOR_PROFILE
    prompt "Candis DVP sensor profile"
    depends on !CANDIS_CAMERA_FIXTURE && !CANDIS_CAMERA_ENABLE_ALL_DVP_SENSORS
    default CANDIS_CAMERA_PROFILE_OV5640
    help
        Select one official DVP sensor for this image. Each choice enables its
        official Espressif driver and DVP auto-detection entry. Use the matching
        sdkconfig.<model> profile for an isolated build.

config CANDIS_CAMERA_PROFILE_BF20A6
    bool "BF20A6"
    select CAMERA_BF20A6
    select CAMERA_BF20A6_AUTO_DETECT_DVP_INTERFACE_SENSOR

config CANDIS_CAMERA_PROFILE_BF3031
    bool "BF3031"
    select CAMERA_BF3031
    select CAMERA_BF3031_AUTO_DETECT_DVP_INTERFACE_SENSOR

config CANDIS_CAMERA_PROFILE_BF3045
    bool "BF3045"
    select CAMERA_BF3045
    select CAMERA_BF3045_AUTO_DETECT_DVP_INTERFACE_SENSOR

config CANDIS_CAMERA_PROFILE_BF3925
    bool "BF3925"
    select CAMERA_BF3925
    select CAMERA_BF3925_AUTO_DETECT_DVP_INTERFACE_SENSOR

config CANDIS_CAMERA_PROFILE_BF3A03
    bool "BF3A03"
    select CAMERA_BF3A03
    select CAMERA_BF3A03_AUTO_DETECT_DVP_INTERFACE_SENSOR

config CANDIS_CAMERA_PROFILE_GC0308
    bool "GC0308"
    select CAMERA_GC0308
    select CAMERA_GC0308_AUTO_DETECT_DVP_INTERFACE_SENSOR

config CANDIS_CAMERA_PROFILE_GC032A
    bool "GC032A"
    select CAMERA_GC032A
    select CAMERA_GC032A_AUTO_DETECT_DVP_INTERFACE_SENSOR

config CANDIS_CAMERA_PROFILE_GC2145
    bool "GC2145"
    select CAMERA_GC2145
    select CAMERA_GC2145_AUTO_DETECT_DVP_INTERFACE_SENSOR

config CANDIS_CAMERA_PROFILE_MT9D111
    bool "MT9D111"
    select CAMERA_MT9D111
    select CAMERA_MT9D111_AUTO_DETECT_DVP_INTERFACE_SENSOR

config CANDIS_CAMERA_PROFILE_OV2640
    bool "OV2640"
    select CAMERA_OV2640
    select CAMERA_OV2640_AUTO_DETECT_DVP_INTERFACE_SENSOR

config CANDIS_CAMERA_PROFILE_OV3640
    bool "OV3640"
    select CAMERA_OV3640
    select CAMERA_OV3640_AUTO_DETECT_DVP_INTERFACE_SENSOR

config CANDIS_CAMERA_PROFILE_OV3660
    bool "OV3660"
    select CAMERA_OV3660
    select CAMERA_OV3660_AUTO_DETECT_DVP_INTERFACE_SENSOR

config CANDIS_CAMERA_PROFILE_OV5640
    bool "OV5640"
    select CAMERA_OV5640
    select CAMERA_OV5640_AUTO_DETECT_DVP_INTERFACE_SENSOR

config CANDIS_CAMERA_PROFILE_SC030IOT
    bool "SC030IOT"
    select CAMERA_SC030IOT
    select CAMERA_SC030IOT_AUTO_DETECT_DVP_INTERFACE_SENSOR

config CANDIS_CAMERA_PROFILE_SC101IOT
    bool "SC101IOT"
    select CAMERA_SC101IOT
    select CAMERA_SC101IOT_AUTO_DETECT_DVP_INTERFACE_SENSOR

config CANDIS_CAMERA_PROFILE_SC2336
    bool "SC2336"
    select CAMERA_SC2336
    select CAMERA_SC2336_AUTO_DETECT_DVP_INTERFACE_SENSOR

config CANDIS_CAMERA_PROFILE_SP0A39
    bool "SP0A39"
    select CAMERA_SP0A39
    select CAMERA_SP0A39_AUTO_DETECT_DVP_INTERFACE_SENSOR

endchoice

config CANDIS_CAMERA_DOCK_V12
    bool "Use the formal Candis Dock v1.2 U7 camera connector"
    default n
    depends on !CANDIS_CAMERA_FIXTURE
    depends on !CANDIS_CAMERA_ENABLE_ALL_DVP_SENSORS
    help
        Use the DVP, XCLK and shared expansion-I2C mapping from the formal Dock
        v1.2 U7 schematic. U7 has no dedicated RESET or PWDN pin.

config CANDIS_CAMERA_DOCK_V12_MANAGE_SUPPLIES
    bool "Enable camera and DC1SW supplies in the Dock example"
    default n
    depends on CANDIS_CAMERA_DOCK_V12
    help
        Enable this only when a module-specific voltage profile is supplied
        and the total DC1SW load is known.

config CANDIS_CAMERA_DOCK_V12_ENABLE_BLDO1
    bool "Enable BLDO1 at the configured voltage"
    default n
    depends on CANDIS_CAMERA_DOCK_V12_MANAGE_SUPPLIES

config CANDIS_CAMERA_DOCK_V12_BLDO1_MV
    int "BLDO1 voltage in mV"
    range 500 3500
    default 2800
    depends on CANDIS_CAMERA_DOCK_V12_MANAGE_SUPPLIES && CANDIS_CAMERA_DOCK_V12_ENABLE_BLDO1

config CANDIS_CAMERA_DOCK_V12_ENABLE_ALDO3
    bool "Enable ALDO3 at the configured voltage"
    default n
    depends on CANDIS_CAMERA_DOCK_V12_MANAGE_SUPPLIES

config CANDIS_CAMERA_DOCK_V12_ALDO3_MV
    int "ALDO3 voltage in mV"
    range 500 3500
    default 1500
    depends on CANDIS_CAMERA_DOCK_V12_MANAGE_SUPPLIES && CANDIS_CAMERA_DOCK_V12_ENABLE_ALDO3

config CANDIS_CAMERA_DOCK_V12_ENABLE_ALDO4
    bool "Enable ALDO4 at the configured voltage"
    default n
    depends on CANDIS_CAMERA_DOCK_V12_MANAGE_SUPPLIES

config CANDIS_CAMERA_DOCK_V12_ALDO4_MV
    int "ALDO4 voltage in mV"
    range 500 3500
    default 2800
    depends on CANDIS_CAMERA_DOCK_V12_MANAGE_SUPPLIES && CANDIS_CAMERA_DOCK_V12_ENABLE_ALDO4

if CANDIS_CAMERA_FIXTURE || CANDIS_CAMERA_DOCK_V12

config CANDIS_CAMERA_FIXTURE_PWDN_GPIO
    bool "Drive OV5640 PWDN using GPIO40"
    default y
    depends on CANDIS_CAMERA_FIXTURE
    help
        Keep enabled when GPIO40 drives the sensor's active-high PWDN.
        Disable when the module holds PWDN low in hardware.

config CANDIS_CAMERA_MANAGE_PANEL_POWER
    bool "Allow the example to enable the AMOLED rail"
    default n
    help
        Enable for a measured setup compatible with a nominal 3.3 V ALDO1.

config CANDIS_CAMERA_QSPI_50MHZ
    bool "Use 50 MHz QSPI for comparison"
    default n

config CANDIS_CAMERA_STILL
    bool "Capture and display a single still frame"
    default n

config CANDIS_CAMERA_SAVE_JPEG
    bool "Save the still frame as a JPEG on the fixture TF card"
    depends on CANDIS_CAMERA_STILL && CANDIS_CAMERA_FIXTURE
    default n
    help
        For the Candis validation fixture. After releasing the camera,
        allow the storage driver to enable DC1SW and create a new JPEG.

config CANDIS_CAMERA_TEST_PATTERN
    bool "Use the selected sensor's test pattern"
    default n
    depends on !CANDIS_CAMERA_ENABLE_ALL_DVP_SENSORS

config CANDIS_CAMERA_YUYV_RGB565
    bool "Convert YUYV to RGB565 with the DVP peripheral"
    depends on !CANDIS_CAMERA_ENABLE_ALL_DVP_SENSORS
    default n
    help
        Requires ESP Video to advertise RGB565X for the active YUYV
        sensor mode. Applies the documented converter output byte order.

endif

endmenu
```

## examples/camera/sdkconfig.defaults
```kconfig
CONFIG_IDF_TARGET="esp32s31"
CONFIG_ESPTOOLPY_FLASHSIZE_16MB=y
CONFIG_PARTITION_TABLE_SINGLE_APP_LARGE=y
CONFIG_FREERTOS_HZ=1000
CONFIG_ESP_CONSOLE_USB_SERIAL_JTAG=y
CONFIG_ESP_CONSOLE_SECONDARY_NONE=y
CONFIG_ESP_MAIN_TASK_STACK_SIZE=8192
CONFIG_SPIRAM=y
CONFIG_VFS_MAX_COUNT=20
CONFIG_ESP_VIDEO_ENABLE_DVP_VIDEO_DEVICE=y
CONFIG_CAMERA_XCLK_USE_LEDC=y
CONFIG_CAMERA_OV5640=y
CONFIG_CAMERA_OV5640_AUTO_DETECT_DVP_INTERFACE_SENSOR=y
CONFIG_CAMERA_OV5640_DVP_RGB565_BE_800X600_10FPS=y
CONFIG_CAMERA_OV5640_DVP_DEFAULT_FMT_RGB565_BE_800X600_10FPS=y
```

## examples/common/candis_example_usb/Kconfig
```kconfig
menu "Candis example USB"

config CANDIS_EXAMPLE_USB_CDC
    bool "Enable native OTG CDC on the Candis USB-C connector"
    default y
    select TINYUSB_CDC_ENABLED
    help
        Start the native USB device and mirror application output to CDC.
        Disable for USB-free power measurements or non-Candis host setups.

config CANDIS_EXAMPLE_USB_DOWNLOAD
    bool "Recognize the full DTR/RTS sequence for app-only download"
    depends on CANDIS_EXAMPLE_USB_CDC
    default y

endmenu
```

## examples/diagnostics/main/Kconfig.projbuild
```kconfig
menu "Candis diagnostics"

config CANDIS_DIAGNOSTICS_STORAGE
    bool "Mount the card and list its root directory"
    default n

config CANDIS_DIAGNOSTICS_FIXTURE
    bool "Use the Candis validation fixture card detect pin"
    depends on CANDIS_DIAGNOSTICS_STORAGE
    default n

config CANDIS_DIAGNOSTICS_DC1SW
    bool "Permit the diagnostic to enable DC1SW"
    depends on CANDIS_DIAGNOSTICS_STORAGE
    default n

config CANDIS_DIAGNOSTICS_OTG
    bool "Use native OTG CDC for byte-exact echo"
    depends on CANDIS_EXAMPLE_USB_CDC
    default n

config CANDIS_DIAGNOSTICS_OTG_DOWNLOAD
    bool "Allow the Candis OTG CDC to hand over to the ROM downloader"
    depends on CANDIS_DIAGNOSTICS_OTG
    default n

config CANDIS_DIAGNOSTICS_AUDIO
    bool "Exercise the codec and its two PCM channels"
    depends on CANDIS_AUDIO
    default n

config CANDIS_DIAGNOSTICS_PLAYBACK
    bool "Emit a short playback test through both speakers"
    depends on CANDIS_DIAGNOSTICS_AUDIO
    default n

config CANDIS_DIAGNOSTICS_RECORD_REPLAY
    bool "Replay the captured stereo clip at reduced volume"
    depends on CANDIS_DIAGNOSTICS_AUDIO
    default n
    help
        Capture 400 ms in RAM and replay once at 20 percent codec volume.
        Connect the characterized microphone and speaker fixture.

endmenu
```
